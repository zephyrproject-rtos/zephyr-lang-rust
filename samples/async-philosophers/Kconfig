## samples/async-philosophers/Kconfig
```kconfig
# Copyright (c) 2024 Linaro LTD
# SPDX-License-Identifier: Apache-2.0

mainmenu "Rust Dining Philosphers"

source "Kconfig.zephyr"

choice
	prompt "Select Synchronization implementation"
	default SYNC_CHANNEL

	config SYNC_SYS_SEMAPHORE
		bool "Use sys::Semaphore to synchronize forks"
		help
		  Use to have the dining philosophers sample use sys::Semaphore, with one per fork, to
		  synchronize.

	config SYNC_SYS_DYNAMIC_SEMAPHORE
		bool "Use a dynamic sys::Semaphore to synchronize forks"
		help
		  Use to have the dining philosophers sample use sys::Semaphore, with one per fork, to
		  synchronize.  The Semaphores will be dynamically allocated.

	config SYNC_SYS_MUTEX
		bool "Use sys::Semaphore to synchronize forks"
		help
		  Use to have the dining philosophers sample use sys::Mutex, with one per fork, to
		  synchronize.

	config SYNC_CONDVAR
		bool "Use sync::Condvar and sync::Mutex to synchronize forks"
		help
		  Use to have the dining philosophers sample use a single data structure, protected
		  by a sync::Mutex and coordinated with a sync::Condvar, to synchronize.

	config SYNC_CHANNEL
		bool "Use sync::channel to synchronize forks"
		help
		  Use to have the dining philosophers sample use a worker thread, communicating via
		  channels to synchronize.

	config SYNC_WORKQUEUE
		bool "Use workqueues to simulate the philosophers"
		help
		  Use workqueues to simulate the philosophers.

endchoice

if SYNC_CHANNEL
	config USE_BOUNDED_CHANNELS
	bool "Should channel sync use bounded channels?"
	default y
	help
	  If set, the channel-based communication will use bounded channels with bounds calculated
	  to not ever block.
endif
```

## samples/async-philosophers/boards/rpi_pico.conf
```kconfig
# Copyright (c) 2024 Linaro LTD
# SPDX-License-Identifier: Apache-2.0

# This board doesn't have a serial console, so use RTT.
CONFIG_UART_CONSOLE=n
CONFIG_RTT_CONSOLE=y
CONFIG_USE_SEGGER_RTT=y
```

## samples/async-philosophers/sample.yaml
```yaml
sample:
  description: Async Philosphers, in Rust
  name: async philosophers rust
common:
  harness: console
  harness_config:
    type: one_line
    regex:
      - "All threads done"
  tags: rust
  filter: CONFIG_RUST_SUPPORTED
  platform_allow:
    - qemu_cortex_m0
    - qemu_cortex_m3
    - qemu_riscv32
    - qemu_riscv64
    - nrf52840dk/nrf52840
tests:
  sample.rust.work-philosopher:
    tags: introduction
    min_ram: 32
```

## samples/bench/sample.yaml
```yaml
sample:
  description: Philosphers, in Rust
  name: philosophers rust
common:
  harness: console
  harness_config:
    type: one_line
    regex:
      # Match message printed at the end.
      - "Done with all tests"
  tags: rust
  filter: CONFIG_RUST_SUPPORTED
  platform_allow:
    - qemu_cortex_m0
    - qemu_cortex_m3
    - qemu_riscv32
    - qemu_riscv64
    - nrf52840dk/nrf52840
    - nrf54l15dk/nrf54l15/cpuapp
tests:
  sample.rust/bench.plain:
    tags: benchmark
    min_ram: 256
```

## samples/blinky/sample.yaml
```yaml
# See doc/develop/test/twister.rst for what is here.
sample:
  name: Blinky Sample
common:
  filter: CONFIG_RUST_SUPPORTED
  platform_allow:
    - qemu_cortex_m0
    - qemu_cortex_m3
    - qemu_riscv32
    - qemu_riscv32/qemu_virt_riscv32/smp
    - qemu_riscv64
    - qemu_riscv64/qemu_virt_riscv64/smp
    - nrf52840dk/nrf52840
tests:
  sample.basic.blinky:
    tags:
      - LED
      - gpio
    filter: dt_enabled_alias_with_parent_compat("led0", "gpio-leds")
    depends_on: gpio
    harness: led
    integration_platforms:
      - frdm_k64f
```

## samples/embassy/sample.yaml
```yaml
sample:
  description: Embassy Hello
  name: hello and basics from Embassy
common:
  harness: console
  harness_config:
    type: one_line
    regex:
      - "Embassy tests passed"
  tags: rust
  filter: CONFIG_RUST_SUPPORTED
  platform_allow:
    - qemu_cortex_m0
    - qemu_cortex_m3
    - qemu_riscv32
    - qemu_riscv64
    - nrf52840dk/nrf52840
tests:
  sample.rust.embassyhello:
    tags: introduction
```

## samples/hello_world/sample.yaml
```yaml
sample:
  description: Hello world, but in Rust
  name: hello rust world
common:
  harness: console
  harness_config:
    type: one_line
    regex:
      - "Hello world from Rust on (.*)"
  tags: rust
  filter: CONFIG_RUST_SUPPORTED
  platform_allow:
    - qemu_cortex_m0
    - qemu_cortex_m3
    - qemu_riscv32
    - qemu_riscv64
    - nrf52840dk/nrf52840
tests:
  sample.rust.helloworld:
    tags: introduction
```

## samples/net/echo_server/boards/qemu_cortex_m3.conf
```kconfig
CONFIG_TEST_RANDOM_GENERATOR=y
CONFIG_NET_QEMU_ETHERNET=y
CONFIG_NET_L2_ETHERNET=y
```

## samples/net/echo_server/sample.yaml
```yaml
# See doc/develop/test/twister.rst for what is here.
sample:
  name: Echo Server Sample
common:
  filter: CONFIG_RUST_SUPPORTED
  platform_allow:
    - qemu_cortex_m3
    - qemu_riscv32
    - qemu_riscv64
tests:
  sample.rust.net.echo_server:
    tags:
      - net
    depends_on: netif
    harness: net
```

## samples/philosophers/Kconfig
```kconfig
# Copyright (c) 2024 Linaro LTD
# SPDX-License-Identifier: Apache-2.0

mainmenu "Rust Dining Philosphers"

source "Kconfig.zephyr"

choice
	prompt "Select Synchronization implementation"
	default SYNC_CONDVAR

	config SYNC_SYS_SEMAPHORE
		bool "Use sys::Semaphore to synchronize forks"
		help
		  Use to have the dining philosophers sample use sys::Mutex, with one per fork, to
		  synchronize.

	config SYNC_SYS_MUTEX
		bool "Use sys::Semaphore to synchronize forks"
		help
		  Use to have the dining philosophers sample use sys::Mutex, with one per fork, to
		  synchronize.

	config SYNC_CONDVAR
		bool "Use sync::Condvar and sync::Mutex to synchronize forks"
		help
		  Use to have the dining philosophers sample use a single data structure, protected
		  by a sync::Mutex and coordinated with a sync::Condvar, to synchronize.

endchoice
```

## samples/philosophers/sample.yaml
```yaml
sample:
  description: Philosphers, in Rust
  name: philosophers rust
common:
  harness: console
  harness_config:
    type: one_line
    regex:
      # Match the statistics, and make sure that each philosopher has at least 10 (two digits)
      # meals.
      - "c:\\[\\d{2,}, \\d{2,}, \\d{2,}, \\d{2,}, \\d{2,}, \\d{2,}\\]"
  tags: rust
  filter: CONFIG_RUST_SUPPORTED
tests:
  sample.rust.philosopher.semaphore:
    tags: introduction
    min_ram: 32
    extra_configs:
      - CONFIG_SYNC_SYS_SEMAPHORE=y
  sample.rust.philosopher.dynsemaphore:
    tags: introduction
    min_ram: 32
    extra_configs:
      - CONFIG_SYNC_SYS_DYNAMIC_SEMAPHORE=y
  sample.rust.philosopher.sysmutex:
    tags: introduction
    min_ram: 32
    extra_configs:
      - CONFIG_SYNC_SYS_MUTEX=y
  sample.rust.philosopher.condvar:
    tags: introduction
    min_ram: 32
    extra_configs:
      - CONFIG_SYNC_CONDVAR=y
  sample.rust.philosopher.channel_bounded:
    tags: introduction
    min_ram: 32
    extra_configs:
      - CONFIG_SYNC_CHANNEL=y
      - CONFIG_USE_BOUNDED_CHANNELS=y
  sample.rust.philosopher.channel_unbounded:
    tags: introduction
    min_ram: 32
    extra_configs:
      - CONFIG_SYNC_CHANNEL=y
      - CONFIG_USE_BOUNDED_CHANNELS=n
```

## samples/work-philosophers/sample.yaml
```yaml
sample:
  description: Philosphers, in Rust
  name: workq philosophers rust
common:
  harness: console
  harness_config:
    type: one_line
    regex:
      - "All threads done"
  tags: rust
  filter: CONFIG_RUST_SUPPORTED
  platform_allow:
    - qemu_cortex_m0
    - qemu_cortex_m3
    - qemu_riscv32
    - qemu_riscv32/qemu_virt_riscv32/smp
    - qemu_riscv64
    - qemu_riscv64/qemu_virt_riscv64/smp
    - nrf52840dk/nrf52840
tests:
  sample.rust.work-philosopher:
    tags: introduction
    min_ram: 32
```

## tests/drivers/gpio-async/testcase.yaml
```yaml
common:
  filter: CONFIG_RUST_SUPPORTED
  platform_allow:
    - rpi_pico
tests:
  test.rust.drivers.gpio-async:
    harness: console
    harness_config:
      type: one_line
      regex:
        # This doesn't actually happen, as this test requires specific hardware and buttons to be
        # pressed.
        - "All tests passed"
```

## tests/drivers/i2c-controller/testcase.yaml
```yaml
common:
  filter: CONFIG_RUST_SUPPORTED
  platform_allow:
    - tiny2040
tests:
  test.rust.drivers.i2c-controller:
    harness: console
    harness_config:
      type: one_line
      regex:
        - "All tests passed"
```

## tests/drivers/i2c-target/testcase.yaml
```yaml
common:
  filter: CONFIG_RUST_SUPPORTED
  platform_allow:
    - tiny2040
tests:
  test.rust.drivers.i2c-target:
    harness: console
    harness_config:
      type: one_line
      regex:
        - "i2c target registered"
```

## tests/drivers/led-strip/testcase.yaml
```yaml
common:
  tags: rust
  filter: CONFIG_RUST_SUPPORTED
  platform_allow:
    - sparkfun_pro_micro_rp2040
tests:
  test.rust.drivers.led-strip:
    harness: console
    harness_config:
      type: one_line
      regex:
        - "All tests passed"
```

## tests/time/testcase.yaml
```yaml
common:
  filter: CONFIG_RUST_SUPPORTED
  platform_allow:
    - qemu_cortex_m0
    - qemu_cortex_m3
    - qemu_riscv32
    - qemu_riscv64
    - nrf52840dk/nrf52840
tests:
  test.rust.time:
    harness: console
    harness_config:
      type: one_line
      regex:
        - "All tests passed"
```
