/* SPDX-License-Identifier: Apache-2.0 */

/ {
	aliases {
		app-uart = &uart_loopback;
	};

	uart_loopback: uart-loopback {
		compatible = "zephyr,uart-emul";
		current-speed = <115200>;
		loopback;
		tx-fifo-size = <256>;
		rx-fifo-size = <256>;
		status = "okay";
	};
};
