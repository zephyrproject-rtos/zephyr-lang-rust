## samples/custom-bindings/sample.yaml
```yaml
sample:
  description: Extend zephyr-sys with application-owned headers and allowlists
  name: Custom Rust bindings
common:
  harness: console
  harness_config:
    type: one_line
    regex:
      - "Custom bindings passed"
  tags: rust
  filter: CONFIG_RUST_SUPPORTED
  platform_allow:
    - qemu_cortex_m0
    - qemu_cortex_m3
    - qemu_riscv32
    - qemu_riscv64
tests:
  sample.rust.custom_bindings: {}
```

## samples/watchdog/sample.yaml
```yaml
# SPDX-License-Identifier: Apache-2.0

sample:
  name: Rust watchdog
  description: Feed an owned watchdog channel from a worker thread, then wait for reset
common:
  tags:
    - rust
    - watchdog
  filter: CONFIG_RUST_SUPPORTED and dt_alias_exists("watchdog0")
  harness: console
  harness_config:
    type: multi_line
    ordered: true
    regex:
      - "Watchdog sample application from Rust"
      - "Feeding watchdog from worker..."
      - "Watchdog fed 5 times"
      - "Waiting for reset..."
      - "Watchdog sample application from Rust"
tests:
  sample.rust.watchdog:
    platform_allow:
      - mps2/an385
      - frdm_mcxa156/mcxa156
    integration_platforms:
      - mps2/an385
      - frdm_mcxa156/mcxa156
```

## tests/drivers/watchdog/testcase.yaml
```yaml
# SPDX-License-Identifier: Apache-2.0

common:
  tags:
    - rust
    - watchdog
  filter: CONFIG_RUST_SUPPORTED
  platform_allow:
    - qemu_cortex_m3
    - native_sim/native/64
  integration_platforms:
    - qemu_cortex_m3
  harness: console
  harness_config:
    type: one_line
    regex:
      - "Watchdog tests passed"
tests:
  test.rust.watchdog: {}
  test.rust.watchdog.multistage:
    extra_configs:
      - CONFIG_TEST_WDT_MULTISTAGE=y
  test.rust.watchdog.disabled:
    extra_configs:
      - CONFIG_WATCHDOG=n
```
