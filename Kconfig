## Kconfig
```kconfig
# Rust configuration options
#
# Copyright (c) 2024 Linaro LTD
# SPDX-License-Identifier: Apache-2.0

menu "Rust Language Support"

config RUST_SUPPORTED
	bool
	default y if ((CPU_CORTEX_M || \
				(RISCV && !RISCV_ISA_RV32E && !RISCV_ISA_RV128I) || \
				XTENSA || \
				(ARCH_POSIX && 64BIT)) && \
				!TIMER_READS_ITS_FREQUENCY_AT_RUNTIME)
	help
	  Selected for platforms that have support for Rust.

config RUST
	bool "Rust support for the application"
	depends on RUST_SUPPORTED
	select EXPERIMENTAL
	help
	  This option enables the use of applications written in Rust.

if RUST

config RUST_ALLOC
	bool "Support an allocator in Rust code"
	help
	  If enabled, the Rust zephyr support library will include support for
	  an allocator.  This allocator will use the currently configured
	  Zephyr allocator (malloc/free).  This this enabled, Rust
	  applications can use the `alloc` crate.

config RUST_BLOCKING_POOL
	bool "Worker pool for offloading blocking calls"
	help
	  Enable a pool of worker threads that run blocking operations off the
	  async executor thread, so a task can await any blocking call, such
	  as a synchronous Zephyr API, instead of stalling the executor.  The
	  pool and its worker threads are allocated and started automatically;
	  application code only needs to enable this option.

	  See the `zephyr::blocking` module.  The pool is a set of worker
	  threads draining a shared FIFO queue, specialized for blocking work.

if RUST_BLOCKING_POOL

config RUST_BLOCKING_POOL_THREADS
	int "Number of blocking-pool worker threads"
	default 1
	range 1 32
	help
	  Number of worker threads draining the shared blocking-work queue.
	  A value greater than 1 lets independent operations run in parallel;
	  operations that contend for the same resource still serialize on
	  that resource's own lock.

config RUST_BLOCKING_POOL_STACK_SIZE
	int "Blocking-pool worker thread stack size (bytes)"
	default 2048
	help
	  Stack size, in bytes, for each blocking-pool worker thread.  Must be
	  large enough for the deepest blocking call path used, plus the
	  largest operation closure and result submitted to the pool.

config RUST_BLOCKING_POOL_PRIORITY
	int "Priority of the blocking-pool worker threads"
	default 5
	help
	  Fixed Zephyr scheduling priority of the blocking-pool worker threads.
	  Blocking work runs at this priority.

config RUST_BLOCKING_POOL_SLOTS
	int "Number of blocking-pool submission slots"
	default 4
	range 1 64
	help
	  Maximum number of blocking operations that may be in flight at once,
	  across the whole application.  A slot holds only fixed-size
	  bookkeeping, so slot count is independent of operation size.

	  When all slots are in use, further submissions wait asynchronously
	  for one to free up rather than failing.

config RUST_BLOCKING_POOL_WAITERS
	int "Number of blocking-pool waiter registrations"
	default 8
	range 1 64
	help
	  Maximum number of tasks that may be waiting for a submission slot at
	  once.  Set this to the number of tasks that may concurrently call
	  `zephyr::blocking::run`.

	  This is independent of RUST_BLOCKING_POOL_SLOTS: slots bound how many
	  operations run at once, while this bounds how many tasks may queue
	  behind them.  Exceeding it still works, but every further registration wakes
	  all the tasks already waiting, wasting CPU while the pool is saturated.

endif # RUST_BLOCKING_POOL

endif # RUST

endmenu
```

## samples/bt-hci-raw/sample.yaml
```yaml
sample:
  description: bt-hci transport over Zephyr HCI RAW, written in Rust
  name: rust bt-hci raw
common:
  build_only: true
  tags: rust bluetooth hci
  filter: CONFIG_RUST_SUPPORTED and CONFIG_BT
  platform_allow:
    - nrf52840dk/nrf52840
tests:
  sample.rust.bt_hci_raw:
    tags: bluetooth
```

## samples/fuel_gauge/boards/mimxrt685_evk_mimxrt685s_cm33.conf
```kconfig
# Keep Zephyr tickrate consistent with embassy tickrate
CONFIG_SYS_CLOCK_TICKS_PER_SEC=10000

# RTT logging
CONFIG_LOG=y
CONFIG_LOG_BACKEND_RTT=y
CONFIG_USE_SEGGER_RTT=y
CONFIG_RTT_CONSOLE=y
CONFIG_LOG_BACKEND_UART=n

# RTT buffer configuration
CONFIG_SEGGER_RTT_BUFFER_SIZE_UP=4096
CONFIG_SEGGER_RTT_BUFFER_SIZE_DOWN=2048
CONFIG_LOG_BUFFER_SIZE=4096
CONFIG_LOG_MODE_IMMEDIATE=y
```

## samples/fuel_gauge/sample.yaml
```yaml
sample:
  description: Fuel Gauge Sample
  name: Fuel Gauge Sample
common:
  tags: rust
  filter: CONFIG_RUST_SUPPORTED
  platform_allow:
    - 'mimxrt685_evk/mimxrt685s/cm33'
    - 'native_sim/native/64'
tests:
  sample.rust.fuelgauge:
    tags: fuel_gauge
```

## samples/rtc/sample.yaml
```yaml
# SPDX-License-Identifier: Apache-2.0

sample:
  name: Rust RTC sample
  description: Set and read an RTC from Rust
common:
  tags:
    - rust
    - rtc
  filter: CONFIG_RUST_SUPPORTED
  platform_allow:
    - qemu_cortex_m3
  integration_platforms:
    - qemu_cortex_m3
  harness: console
  harness_config:
    type: one_line
    regex:
      - "RTC sample successful"
  timeout: 15
tests:
  sample.rust.rtc: {}
```

## samples/sensor/bmi270/sample.yaml
```yaml
# Copyright (c) 2025
# SPDX-License-Identifier: Apache-2.0

sample:
  name: BMI270 Rust Sample
  description: BMI270 6-axis IMU sensor sample in Rust

common:
  filter: CONFIG_RUST_SUPPORTED
  platform_allow:
    - cy8ckit_062s2_ai

tests:
  sample.rust.sensor.bmi270:
    tags:
    - sensor
    - bmi270
    filter: dt_enabled_alias_with_parent_compat("accel0", "bosch,bmi270")
    depends_on: sensor
    harness: bmi270
```

## samples/sensor/pressure_polling/sample.yaml
```yaml
# SPDX-License-Identifier: Apache-2.0

sample:
  name: Pressure polling sample (Rust)
common:
  filter: CONFIG_RUST_SUPPORTED
tests:
  sample.rust.sensor.pressure_polling:
    tags:
      - sensor
      - pressure
    filter: dt_alias_exists("pressure-sensor")
    build_only: true
```

## samples/sensor/sample.yaml
```yaml
sample:
  description: Demonstrate the Rust sensor wrapper
  name: Async sensor
common:
  filter: CONFIG_RUST_SUPPORTED
  platform_allow:
    - nucleo_f411re
  tags:
    - rust
    - sensor
  harness: console
  harness_config:
    type: one_line
    regex:
      - 'Temperature: -?[0-9]+\.[0-9]{3} C'
tests:
  sample.rust.sensor: {}
```
